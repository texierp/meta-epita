## conf/layer.conf
```bitbake
# We have a conf and classes directory, add to BBPATH
BBPATH .= ":${LAYERDIR}"

# We have recipes-* directories, add to BBFILES
BBFILES += "${LAYERDIR}/recipes-*/*/*.bb \
            ${LAYERDIR}/recipes-*/*/*.bbappend"

BBFILE_COLLECTIONS += "meta-epita"
BBFILE_PATTERN_meta-epita = "^${LAYERDIR}/"
BBFILE_PRIORITY_meta-epita = "6"

LAYERDEPENDS_meta-epita = "core"
LAYERSERIES_COMPAT_meta-epita = "hardknott"
```
